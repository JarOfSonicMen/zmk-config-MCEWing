## config/boards/shields/mcewing/Kconfig.defconfig
```kconfig
# Copyright (c) 2020 Derek Schmell
# SPDX-License-Identifier: MIT


if SHIELD_MCEWING_LEFT

config ZMK_KEYBOARD_NAME
    default "MCEWing"

config ZMK_SPLIT_ROLE_CENTRAL
    default y

endif

if SHIELD_MCEWING_LEFT || SHIELD_MCEWING_RIGHT

config ZMK_SPLIT
    default y

endif
```

## config/boards/shields/mcewing/example/Kconfig.shield
```kconfig
# Copyright (c) 2020 Derek Schmell
# SPDX-License-Identifier: MIT

config SHIELD_MCEWING_LEFT
    def_bool $(shields_list_contains,mcewing_left)

config SHIELD_MCEWING_RIGHT
    def_bool $(shields_list_contains,mcewing_right)
```
